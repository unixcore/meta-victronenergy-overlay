## conf/layer.conf
```bitbake
# add conf and classes directory to BBPATH
BBPATH := "${BBPATH}:${LAYERDIR}"

# add the recipes to BBFILES
BBFILES := "${BBFILES} \
	${LAYERDIR}/recipes-*/*/*.bb \
	${LAYERDIR}/recipes-*/*/*/*.bb \
	${LAYERDIR}/recipes-*/*/*.bbappend \
	${LAYERDIR}/recipes-*/*/*/*.bbappend"

BBFILE_COLLECTIONS += "victronenergy-overlay"
BBFILE_PATTERN_victronenergy-overlay := "^${LAYERDIR}/"
BBFILE_PRIORITY_victronenergy-overlay = "7"
```
